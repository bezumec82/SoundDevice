## EndPoint/MicroChip/u-boot-at91/configs/sama5d27_sound_device_defconfig
```kconfig
CONFIG_ARM=y
CONFIG_ARCH_AT91=y
CONFIG_TARGET_SAMA5D2_SOUND_DEVICE=y
CONFIG_BOOTDELAY=3
# CONFIG_DISPLAY_BOARDINFO is not set
# CONFIG_SYS_MMCSD_RAW_MODE_U_BOOT_USE_SECTOR is not set
CONFIG_SYS_PROMPT="u-boot> "

### SPL ###
# CONFIG_SPL is not set
# CONFIG_SPL_BUILD is not set
# CONFIG_SPL_SPI_LOAD is not set
CONFIG_SPL_PINCTRL=y
CONFIG_SPL_GPIO_SUPPORT is not set
CONFIG_SPL_LIBCOMMON_SUPPORT is not set
CONFIG_SPL_LIBGENERIC_SUPPORT is not set
CONFIG_SPL_SERIAL_SUPPORT is not set
CONFIG_SPL_DRIVERS_MISC_SUPPORT is not set
CONFIG_SPL_SPI_FLASH_SUPPORT is not set
CONFIG_SPL_SPI_SUPPORT is not set
CONFIG_SPL_DM is not set
CONFIG_SPL_DM_SEQ_ALIAS is not set
CONFIG_SYS_MALLOC_F_LEN=0x2000

CONFIG_DEBUG_UART=y
CONFIG_FIT=y
CONFIG_SYS_EXTRA_OPTIONS="SAMA5D2"

### BOOT ###
# CONFIG_QSPI_BOOT is not set
# CONFIG_SD_BOOT is not set
# CONFIG_QSPI_SD_BOOT is not set
CONFIG_TFTP_BOOT=y

### HUSH ###
CONFIG_HUSH_PARSER=y
CONFIG_CMD_BOOTZ=y
# CONFIG_CMD_IMI is not set
# CONFIG_CMD_IMLS is not set
# CONFIG_CMD_LOADS is not set
# CONFIG_CMD_FLASH is not set
CONFIG_CMD_MMC=y
CONFIG_CMD_SF=y
CONFIG_CMD_I2C=y
CONFIG_CMD_USB is not set
# CONFIG_CMD_FPGA is not set
CONFIG_CMD_DHCP=y
CONFIG_CMD_PING=y
CONFIG_CMD_EXT4=y
CONFIG_CMD_FAT=y
CONFIG_CMD_ENV_FLAGS=y

### Device tree ###
CONFIG_DEFAULT_DEVICE_TREE="sama5d27_sound_device"
CONFIG_OF_CONTROL=y
CONFIG_SPL_OF_CONTROL is not set
CONFIG_OF_SPL_REMOVE_PROPS="interrupts interrupt-parent dmas dma-names"
# CONFIG_OF_TRANSLATE is not set

CONFIG_DM=y
CONFIG_DM_GPIO=y
CONFIG_ATMEL_PIO4=y

### I2C ###
CONFIG_DM_I2C=y
CONFIG_SYS_I2C_AT91=y

### SD ###
CONFIG_DM_MMC=y
CONFIG_MMC_SDHCI=y
CONFIG_MMC_SDHCI_ATMEL=y

### MAC ###
CONFIG_DM_ETH=y
CONFIG_MACB=y

CONFIG_CLK=y
CONFIG_SPL_CLK=y
CONFIG_CLK_AT91=y

CONFIG_AT91_UTMI=y
CONFIG_AT91_H32MX=y
CONFIG_AT91_GENERIC_CLK=y

CONFIG_PINCTRL=y

CONFIG_PINCTRL_AT91PIO4=y

### UART ###
CONFIG_DM_SERIAL=y
CONFIG_DEBUG_UART_ATMEL=y
CONFIG_DEBUG_UART_BASE=0xf8020000
CONFIG_DEBUG_UART_CLOCK=82000000
CONFIG_DEBUG_UART_BOARD_INIT=y
CONFIG_DEBUG_UART_ANNOUNCE=y
CONFIG_ATMEL_USART=y

### SPI ###
CONFIG_DM_SPI=y
CONFIG_ATMEL_QSPI=y
CONFIG_ATMEL_SPI=y

### FLASH ###
CONFIG_DM_SPI_FLASH=y
CONFIG_SPI_FLASH=y
CONFIG_SPI_FLASH_ATMEL=y
CONFIG_SPI_FLASH_MACRONIX=y
CONFIG_SPI_FLASH_STMICRO=y
CONFIG_SPI_FLASH_SST=y

### USB ###
# CONFIG_USB is not set
# CONFIG_DM_USB is not set
# CONFIG_USB_EHCI_HCD is not set
# CONFIG_USB_STORAGE is not set
# CONFIG_USB_GADGET is not set
# CONFIG_USB_GADGET_ATMEL_USBA is not set
```

## EndPoint/TI/am335x/ti-u-boot/configs/am335x_boneblack_defconfig
```kconfig
CONFIG_ARM=y
CONFIG_ARCH_OMAP2PLUS=y

CONFIG_AM33XX=y
# CONFIG_DISTRO_DEFAULTS is not set
# CONFIG_TI_COMMON_CMD_OPTIONS is not set

# If you set it, you can't parse 'mkimage'
# CONFIG_FIT_SIGNATURE is not set
CONFIG_FIT_VERBOSE=y
CONFIG_SYS_EXTRA_OPTIONS=""

# CONFIG_SYS_CONSOLE_INFO_QUIET is not set
CONFIG_VERSION_VARIABLE=y
CONFIG_ARCH_MISC_INIT=y

CONFIG_SPL=y
CONFIG_SPL_NET_SUPPORT=y
CONFIG_SPL_NET_VCI_STRING="AM335x U-Boot SPL"
CONFIG_SPL_MUSB_NEW_SUPPORT=y
CONFIG_SPL_USB_GADGET_SUPPORT=y
CONFIG_SPL_USB_ETHER=y
CONFIG_SPL_ETH_SUPPORT=y
CONFIG_SPL_SERIAL_SUPPORT=y

# CONFIG_SPL_OS_BOOT is not set
CONFIG_SPL_FIT=y
CONFIG_SPL_LOAD_FIT=y
# CONFIG_SPL_LOAD_FIT_FULL is not set
CONFIG_SPL_FIT_PRINT=y
# CONFIG_SPL_GZIP is not set
CONFIG_SPL_PAYLOAD="fit.itb"
# CONFIG_SPL_USE_ARCH_MEMCPY is not set

# CONFIG_SPL_MMC_SUPPORT is not set
# CONFIG_SPL_NAND_SUPPORT is not set
# CONFIG_SPL_YMODEM_SUPPORT is not set
# CONFIG_SPL_FAT_SUPPORT is not set

### gpio used in board.c
### TODO: remove
CONFIG_SPL_GPIO_SUPPORT=y
CONFIG_SPL_OF_LIBFDT=y

CONFIG_SPL_I2C_SUPPORT=y 
CONFIG_SPL_POWER_SUPPORT=y
CONFIG_SPL_AM33XX_ENABLE_RTC32K_OSC=y
# CONFIG_SPL_DMA_SUPPORT is not set
CONFIG_SPL_STACK_R_MALLOC_SIMPLE_LEN=0xf00000

CONFIG_AUTOBOOT_KEYED=y
CONFIG_AUTOBOOT_PROMPT="Press SPACE to abort autoboot in %d seconds\n"
CONFIG_AUTOBOOT_DELAY_STR="d"
CONFIG_AUTOBOOT_STOP_STR=" "

#######
### CMD
#######
CONFIG_CMD_DHCP=y
CONFIG_CMD_PING=y
CONFIG_CMD_BOOTZ=y
# CONFIG_CMD_SPL is not set
# CONFIG_EFI_LOADER is not set
# CONFIG_CMD_BOOTEFI is not set
# CONFIG_CMD_LOADB is not set
# CONFIG_CMD_LOADS is not set
# CONFIG_CMD_FS_GENERIC is not set
# CONFIG_PARTITIONS is not set
# CONFIG_FS_FAT is not set
# CONFIG_CMD_FAT is not set
# CONFIG_CMD_EXT2 is not set
# CONFIG_CMD_EXT4 is not set
# CONFIG_CMD_TIME is not set
# CONFIG_CMD_PART is not set
# CONFIG_CMD_DM is not set
# CONFIG_RANDOM_UUID is not set
# CONFIG_CMD_MMC is not set
# CONFIG_CMD_GPT is not set
# CONFIG_MD5 is not set
CONFIG_CMD_CRC32=y
CONFIG_CMD_HASH=y

# CONFIG_CMD_FLASH is not set
# CONFIG_CMD_SETEXPR is not set
# CONFIG_CMD_SPI is not set

CONFIG_DEFAULT_DEVICE_TREE="am335x-boneblack"

CONFIG_ENV_IS_NOWHERE=y
# CONFIG_ENV_VARS_UBOOT_RUNTIME_CONFIG is not set
# CONFIG_BLK is not set
CONFIG_BOOTCOUNT_LIMIT=y
# CONFIG_DFU_MMC is not set
# CONFIG_DFU_RAM is not set
# CONFIG_USB_FUNCTION_FASTBOOT is not set

#######
### ETH
#######
CONFIG_ETH_SUPPORT=y
CONFIG_BOOTP_VCI_STRING="AM335x U-Boot"
# CONFIG_PHY_GIGE is not set
CONFIG_MII=y
CONFIG_DRIVER_TI_CPSW=y

# CONFIG_SPI is not set
# CONFIG_OMAP3_SPI is not set
# CONFIG_SPI_FLASH is not set
# CONFIG_SPI_FLASH_WINBOND is not set

#######
### USB
#######
CONFIG_USB=y
CONFIG_USB_MUSB_HOST=y
CONFIG_USB_MUSB_GADGET=y
CONFIG_USB_MUSB_TI=y
CONFIG_USB_MUSB_DSPS=y
CONFIG_USB_GADGET=y
CONFIG_USB_GADGET_MANUFACTURER="Texas Instruments"
CONFIG_USB_GADGET_VENDOR_NUM=0x0451
CONFIG_USB_GADGET_PRODUCT_NUM=0xd022
CONFIG_USB_ETHER=y

CONFIG_LZO=y
CONFIG_OF_LIBFDT=y
### To build internal DTC
### ERROR : no rule to make target 'arch/arm/dts/unset.dts' 
###         needed by 'arch/arm/dts/unset.dtb'
CONFIG_OF_CONTROL=y

# CONFIG_MMC is not set
# CONFIG_SYS_MMCSD_RAW_MODE_U_BOOT_USE_SECTOR is not set


# CONFIG_DM_PMIC_TPS65910 is not set
# CONFIG_POWER_TPS65910 is not set
```
