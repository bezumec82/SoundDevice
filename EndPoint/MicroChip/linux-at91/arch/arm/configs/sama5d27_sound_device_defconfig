## EndPoint/MicroChip/linux-at91/arch/arm/configs/sama5d27_sound_device_defconfig
```kconfig
#####################
### General setup ###
#####################
# CONFIG_SWAP is not set
# CONFIG_LOCALVERSION_AUTO is not set

### Inter Process Communication is a suite of library functions and system calls 
### which let processes (running programs) synchronize and exchange information. 
CONFIG_SYSVIPC=y
### POSIX variant of message queues is a part of IPC
CONFIG_POSIX_MQUEUE=y

### To directly read from or write to another process' address space
CONFIG_CROSS_MEMORY_ATTACH=y

### User level program will be able to map file names 
### to handle and then later use the handle for different file system operations.
# CONFIG_FHANDLE is not set

###### Kernel log buffer size (16 => 64KB, 17 => 128KB)
CONFIG_LOG_BUF_SHIFT=17

###### Control Group support
# CONFIG_CGROUPS is not set

###### Namespaces support
CONFIG_NAMESPACES=y
### User namespace
CONFIG_USER_NS=y

###### General setup -> IRQ subsystem
CONFIG_IRQ_DOMAIN_DEBUG=y

###### General setup -> Timer subsystem
CONFIG_NO_HZ_IDLE=y
CONFIG_HIGH_RES_TIMERS=y

# CONFIG_BLK_DEV_INITRD is not set

######  General setup -> Configure standard kernel features
### Load all symbols for debugging/ksymoops
# CONFIG_KALLSYMS is not set

CONFIG_EMBEDDED=y
CONFIG_SLAB=y
###### Optimize very unlikely/likely branches
CONFIG_JUMP_LABEL=y



######################################
### Enable loadable module support ###
######################################
CONFIG_MODULES=y
CONFIG_MODULE_FORCE_LOAD=y
CONFIG_MODULE_UNLOAD=y
CONFIG_MODULE_FORCE_UNLOAD=y



##############################
### Enable the block layer ###
##############################
# CONFIG_BLK_DEV_BSG is not set

###### Enable the block layer -> IO Schedulers
### Deadline I/O scheduler
# CONFIG_IOSCHED_DEADLINE is not set
### IO Schedulers
# CONFIG_IOSCHED_CFQ is not set



###################
### System Type ###
###################
CONFIG_ARCH_AT91=y
CONFIG_SOC_SAMA5D2=y
# CONFIG_SOC_SAMA5D3 is not set
# CONFIG_SOC_SAMA5D4 is not set 



###################
### Bus support ###
###################
# CONFIG_PCI is not set
# CONFIG_PCCARD is not set



#######################
### Kernel features ###
#######################

######  Use the ARM EABI to compile the kernel
CONFIG_AEABI=y

###### Contiguous Memory Allocator
CONFIG_CMA=y
CONFIG_CMA_DEBUGFS=y

### The largest power of two that the kernel keeps in the memory allocator
CONFIG_FORCE_MAX_ZONEORDER=15

###### Use kernel mem{cpy,set}() for {copy_to,clear}_user()
### Implement faster copy_to_user and clear_user methods for CPU cores 
### where a 8-word STM instruction give significantly higher memory write throughput 
### than a sequence of individual 32bit stores.
CONFIG_UACCESS_WITH_MEMCPY=y



####################
### Boot options ###
####################
CONFIG_USE_OF=y

###### Support for the traditional ATAGS boot data passing
# CONFIG_ATAGS is not set

###### Compressed ROM boot loader base address
### The physical address at which the ROM-able zImage is to be placed in the target.
CONFIG_ZBOOT_ROM_TEXT=0x0

###### Compressed ROM boot loader BSS address
CONFIG_ZBOOT_ROM_BSS=0x0

CONFIG_CMDLINE="console=ttyS0,115200 earlyprintk root=/dev/mmcblk0p2 rw rootwait"

### 'kexec' is a system call that implements the ability to shutdown your current kernel,
### and to start another kernel.
# CONFIG_KEXEC is not set



############################
### CPU Power Management ###
############################
### Generic framework for supporting software-controlled idle processor power management.
CONFIG_CPU_IDLE=y



################################
### Floating point emulation ###
################################
### VFP support code in the kernel
CONFIG_VFP=y
### Support code for NEON, the ARMv7 Advanced SIMD Extension.
CONFIG_NEON=y
CONFIG_KERNEL_MODE_NEON=y


################################
### Userspace binary formats ###
################################
### Will enable your kernel to run ELF binaries and enlarge it by about 13 KB
CONFIG_BINFMT_ELF=y
# CONFIG_CORE_DUMP_DEFAULT_ELF_HEADERS is not set
### to execute interpreted scripts starting with #! 
### followed by the path to an interpreter.
CONFIG_BINFMT_SCRIPT=y
### Support for performing core dumps
CONFIG_COREDUMP=y



################################
### Power management options ###
################################
###### Power Management Debug Support
CONFIG_PM_DEBUG=y
###### Extra PM attributes in sysfs for low-level debugging/testing
CONFIG_PM_ADVANCED_DEBUG=y



##########################
### Networking support ###
##########################
CONFIG_NET=y
###### -> Networking options
CONFIG_PACKET=y
CONFIG_UNIX=y
### -> UNIX: socket monitoring interface
CONFIG_UNIX_DIAG=y

CONFIG_INET=y
CONFIG_IP_MULTICAST=y

### This enables automatic configuration of IP addresses of devices 
### and of the routing table during kernel boot
CONFIG_IP_PNP=y
# CONFIG_IP_PNP_DHCP is not set

### -> INET: socket monitoring interface
CONFIG_INET_DIAG=y
### -> UDP: socket monitoring interface
CONFIG_INET_UDP_DIAG=y

# CONFIG_IPV6 is not set

# CONFIG_INET_XFRM_MODE_TRANSPORT is not set
# CONFIG_INET_XFRM_MODE_TUNNEL is not set
# CONFIG_INET_XFRM_MODE_BEET is not set
# CONFIG_INET_LRO is not set

###### ->  CAN bus subsystem support
CONFIG_CAN=y
CONFIG_CAN_AT91=y
CONFIG_CAN_M_CAN=y

###### -> RF switch subsystem support
# CONFIG_RFKILL is not set

###### -> Wireless
# CONFIG_CFG80211 is not set



######################
### Device Drivers ###
######################

###### -> Generic Driver Options
# CONFIG_UEVENT_HELPER is not set
CONFIG_DEVTMPFS=y
CONFIG_DEVTMPFS_MOUNT=y

####### -> Select only drivers that don't need compile-time external firmware
# CONFIG_STANDALONE is not set
###### -> External firmware blobs to build into the kernel binary
# CONFIG_PREVENT_FIRMWARE_BUILD is not set

###### -> DMA Contiguous Memory Allocator
CONFIG_DMA_CMA=y



####################################################
###### -> Memory Technology Device (MTD) support ###
####################################################
CONFIG_MTD=y
###### -> MTD tests support (DANGEROUS) 
CONFIG_MTD_TESTS=m
CONFIG_MTD_CMDLINE_PARTS=y
CONFIG_MTD_OF_PARTS=y

###### -> Caching block device access to MTD devices
### At the moment, it is also required for the Journalling Flash File System(s)
### to obtain a handle on the MTD device when it's mounted
CONFIG_MTD_BLOCK=y

###### -> RAM/ROM/Flash chip drivers
CONFIG_MTD_CFI is not set
###### -> Self-contained MTD device drivers
###### -> Support most SPI Flash chips (AT26DF, M25P, W25X, ...)
CONFIG_MTD_M25P80 is not set

CONFIG_MTD_NAND is not set

CONFIG_MTD_SPI_NOR=y
CONFIG_SPI_ATMEL_QUADSPI=y

CONFIG_MTD_UBI=y
CONFIG_MTD_UBI_FASTMAP=y
CONFIG_MTD_UBI_GLUEBI=m


### Device Tree and Open Firmware support ###
CONFIG_OF=y

#####################
### Block devices ###
#####################
###### -> Loopback device support
# CONFIG_BLK_DEV_LOOP is not set

###### ->  RAM block device support
CONFIG_BLK_DEV_RAM is not set


####################
### Misc devices ###
####################
###### -> Atmel AT32/AT91 Timer/Counter Library
CONFIG_ATMEL_TCLIB=y
###### -> Device driver for Atmel SSC peripheral
CONFIG_ATMEL_SSC=y
###### -> EEPROM support
CONFIG_EEPROM_AT24=y

###### -> SCSI device support (USB)
CONFIG_SCSI=y

### If you want to use SCSI hard disks, Fibre Channel disks,
### Serial ATA (SATA) or Parallel ATA (PATA) hard disks, 
### USB storage or the SCSI or parallel port version of 
### the IOMEGA ZIP drive
CONFIG_BLK_DEV_SD=y
# CONFIG_SCSI_LOWLEVEL is not set


##############################
### Network device support ###
##############################
CONFIG_NETDEVICES=y
# CONFIG_NET_VENDOR_ARC is not set
CONFIG_MACB=y
# CONFIG_NET_VENDOR_BROADCOM is not set
# CONFIG_NET_VENDOR_CIRRUS is not set
# CONFIG_NET_VENDOR_EZCHIP is not set
# CONFIG_NET_VENDOR_FARADAY is not set
# CONFIG_NET_VENDOR_HISILICON is not set
# CONFIG_NET_VENDOR_INTEL is not set
# CONFIG_NET_VENDOR_MARVELL is not set
# CONFIG_NET_VENDOR_MICREL is not set
# CONFIG_NET_VENDOR_MICROCHIP is not set
# CONFIG_NET_VENDOR_NATSEMI is not set
# CONFIG_NET_VENDOR_QUALCOMM is not set
# CONFIG_NET_VENDOR_RENESAS is not set
# CONFIG_NET_VENDOR_ROCKER is not set
# CONFIG_NET_VENDOR_SAMSUNG is not set
# CONFIG_NET_VENDOR_SEEQ is not set
# CONFIG_NET_VENDOR_SMSC is not set
# CONFIG_NET_VENDOR_STMICRO is not set
# CONFIG_NET_VENDOR_SYNOPSYS is not set
# CONFIG_NET_VENDOR_VIA is not set
# CONFIG_NET_VENDOR_WIZNET is not set
CONFIG_MICREL_PHY=y
###### -> USB Network Adapters
# CONFIG_USB_NET_DRIVERS is not set

###### -> Wireless LAN
# CONFIG_WLAN is not set


############################
### Input device support ###
############################
# CONFIG_INPUT_LEDS is not set
# CONFIG_INPUT_MOUSEDEV is not set
###### -> Event interface
# CONFIG_INPUT_EVDEV is not set
# CONFIG_INPUT_KEYBOARD is not set
# CONFIG_INPUT_MOUSE is not set
# CONFIG_INPUT_TOUCHSCREEN is not set
# CONFIG_INPUT_MISC is not set


#########################
### Character devices ###
#########################
CONFIG_TTY=y
# CONFIG_SERIO is not set
CONFIG_LEGACY_PTY_COUNT=4
CONFIG_SERIAL_ATMEL=y
CONFIG_SERIAL_ATMEL_CONSOLE=y
CONFIG_HW_RANDOM=y


###################
### I2C support ###
###################
CONFIG_I2C_COMPAT=y
CONFIG_I2C_CHARDEV=y
###### -> I2C Hardware Bus support
###### -> Atmel AT91 I2C Two-Wire interface (TWI)
CONFIG_I2C_AT91=y
###### -> GPIO-based bitbanging I2C
# CONFIG_I2C_GPIO is not set
CONFIG_I2C_HELPER_AUTO=y

###################
### SPI support ###
###################
CONFIG_SPI=y
CONFIG_SPI_ATMEL=y
CONFIG_SPI_GPIO=y
CONFIG_SPI_SPIDEV=m


####################
### GPIO support ###
####################
CONFIG_GPIO_SYSFS=y


######################################
### Board level reset or power off ###
######################################
CONFIG_POWER_RESET=y
CONFIG_POWER_RESET_AT91_POWEROFF=y
CONFIG_POWER_RESET_AT91_RESET=y
CONFIG_POWER_RESET_AT91_SAMA5D2_SHDWC=y

##################################
### Power supply class support ###
##################################
# CONFIG_POWER_SUPPLY is not set


###### -> Hardware Monitoring support
# CONFIG_HWMON is not set


##############################
### Watchdog Timer Support ###
##############################
CONFIG_WATCHDOG=y
CONFIG_AT91SAM9X_WATCHDOG=y
CONFIG_SAMA5D4_WATCHDOG=y
CONFIG_WATCHDOG_SYSFS=y


###### -> Voltage and Current Regulator Support
CONFIG_REGULATOR is not set


CONFIG_MFD_ACT8945A=y
CONFIG_MFD_ATMEL_FLEXCOM=y
CONFIG_MFD_ATMEL_HLCDC=y


###### -> Multimedia support
# CONFIG_MEDIA_SUPPORT is not set

###### -> Graphics support
CONFIG_DRM is not set
CONFIG_BACKLIGHT_LCD_SUPPORT is not set

##########################
### Sound card support ###
##########################
CONFIG_SOUND_OSS_CORE_PRECLAIM=y
CONFIG_SOUND=y
CONFIG_SND=y
CONFIG_SND_SEQUENCER=y
CONFIG_SND_SEQ_DUMMY=y
CONFIG_SND_MIXER_OSS=y
CONFIG_SND_PCM_OSS=y
CONFIG_SND_PCM_OSS_PLUGINS=y
CONFIG_SND_PCM_TIMER=y
CONFIG_SND_SEQUENCER_OSS=y
CONFIG_SND_HRTIMER=y
CONFIG_SND_SEQ_HRTIMER_DEFAULT=y
CONFIG_SND_SUPPORT_OLD_API=y
CONFIG_SND_PROC_FS=y
CONFIG_SND_VERBOSE_PROCFS=y

CONFIG_SND_DRIVERS=y
CONFIG_SND_DUMMY=y
CONFIG_SND_ALOOP=y
CONFIG_SND_VIRMIDI=y

CONFIG_SND_ARM=y
CONFIG_SND_ATMEL_AC97C=y

CONFIG_SND_SPI=y
CONFIG_SND_AT73C213=y

CONFIG_SND_SOC=y
CONFIG_SND_ATMEL_SOC=y

CONFIG_SND_ATMEL_SOC_CLASSD=y
CONFIG_SND_ATMEL_SOC_PDMIC=y
CONFIG_SND_ATMEL_SOC_I2S=y

CONFIG_SND_SOC_MAX98504=y
CONFIG_SND_SOC_MAX9860=y

###### -> HID support
# CONFIG_HID is not set
# CONFIG_HID_GENERIC is not set
# CONFIG_USB_HID is not set


###################
### USB support ###
###################
CONFIG_USB=y
CONFIG_USB_ANNOUNCE_NEW_DEVICES=y
CONFIG_USB_OTG=y
CONFIG_USB_LEDS_TRIGGER_USBPORT=y
CONFIG_USB_XHCI_HCD=y
CONFIG_USB_XHCI_PLATFORM=y

CONFIG_USB_EHCI_HCD=y
CONFIG_USB_OHCI_HCD=y
CONFIG_USB_ACM=y

CONFIG_USB_STORAGE=y

CONFIG_USB_GADGET=y
CONFIG_USB_ATMEL_USBA=y

CONFIG_USB_CONFIGFS=y
CONFIG_USB_CONFIGFS_ACM=y
CONFIG_USB_CONFIGFS_MASS_STORAGE=y
CONFIG_USB_ZERO=y
# CONFIG_USB_MASS_STORAGE is not set

CONFIG_USB_LED_TRIG=y

################################
### MMC/SD/SDIO card support ###
################################
CONFIG_MMC=y
# CONFIG_PWRSEQ_EMMC is not set
CONFIG_PWRSEQ_SIMPLE=y
CONFIG_MMC_BLOCK=y

# CONFIG_MMC_BLOCK_BOUNCE is not set
CONFIG_MMC_SDHCI=y
CONFIG_MMC_SDHCI_PLTFM=y
CONFIG_MMC_SDHCI_OF_AT91=y
CONFIG_MMC_ATMELMCI=y


###################
### LED Support ###
###################
CONFIG_NEW_LEDS=y
CONFIG_LEDS_CLASS=y
CONFIG_LEDS_CLASS_FLASH=y
CONFIG_LEDS_GPIO=y
CONFIG_LEDS_PWM=y
CONFIG_LEDS_REGULATOR=y
CONFIG_LEDS_SYSCON=y

CONFIG_LEDS_TRIGGERS=y
CONFIG_LEDS_TRIGGER_TIMER=y
CONFIG_LEDS_TRIGGER_ONESHOT=y
CONFIG_LEDS_TRIGGER_MTD=y
CONFIG_LEDS_TRIGGER_HEARTBEAT=y
CONFIG_LEDS_TRIGGER_CPU=y
CONFIG_LEDS_TRIGGER_GPIO=y
CONFIG_LEDS_TRIGGER_DEFAULT_ON=y
CONFIG_LEDS_TRIGGER_TRANSIENT=y
CONFIG_LEDS_TRIGGER_PANIC=y


#######################
### Real Time Clock ###
#######################
CONFIG_RTC_CLASS=y
CONFIG_RTC_HCTOSYS=y
CONFIG_RTC_SYSTOHC=y

CONFIG_RTC_DRV_AT91RM9200=y
CONFIG_RTC_DRV_AT91SAM9=y


##########################
### DMA Engine support ###
##########################
CONFIG_DMADEVICES=y
CONFIG_AT_HDMAC=y
CONFIG_AT_XDMAC=y


#######################
### Staging drivers ###
#######################
CONFIG_STAGING=y


#################################
### Memory Controller drivers ###
#################################
CONFIG_MEMORY=y
CONFIG_ATMEL_SDRAMC=y
CONFIG_ATMEL_EBI=y



##############################
### IOMMU Hardware Support ###
##############################
# CONFIG_IOMMU_SUPPORT is not set


##############################
### Industrial I/O support ###
##############################
CONFIG_IIO=y
CONFIG_IIO_BUFFER=y
CONFIG_IIO_KFIFO_BUF=y
CONFIG_IIO_TRIGGER=y

###### -> Analog to digital converters
CONFIG_AT91_ADC=y
CONFIG_AT91_SAMA5D2_ADC=y


############################################
### Pulse-Width Modulation (PWM) Support ###
############################################
CONFIG_PWM=y
CONFIG_PWM_ATMEL=y
CONFIG_PWM_ATMEL_HLCDC_PWM=y
CONFIG_PWM_ATMEL_TCB=y


#####################
### NVMEM Support ###
#####################
CONFIG_NVMEM=y

CONFIG_WILC1000_SDIO=m


####################
### File systems ###
####################
CONFIG_EXT3_FS=y
CONFIG_EXT4_FS=y
CONFIG_EXT4_USE_FOR_EXT2=y
CONFIG_FILE_LOCKING=y
CONFIG_MANDATORY_FILE_LOCKING=y
CONFIG_DNOTIFY=y
CONFIG_INOTIFY_USER=y
CONFIG_FANOTIFY=y
CONFIG_OVERLAY_FS=y

CONFIG_VFAT_FS=y
CONFIG_TMPFS=y
CONFIG_CONFIGFS_FS=y

CONFIG_UBIFS_FS=y
CONFIG_UBIFS_FS_ADVANCED_COMPR=y
CONFIG_UBIFS_FS_LZO=y
CONFIG_UBIFS_FS_ZLIB=y

# CONFIG_NETWORK_FILESYSTEMS is not set

CONFIG_NLS_CODEPAGE_437=y
CONFIG_NLS_CODEPAGE_850=y
CONFIG_NLS_ISO8859_1=y
CONFIG_NLS_UTF8=y



###################################
### Debug memory initialisation ###
###################################
CONFIG_STRIP_ASM_SYMS=y
CONFIG_DEBUG_FS=y
CONFIG_DEBUG_MEMORY_INIT=y
# CONFIG_SCHED_DEBUG is not set
# CONFIG_FTRACE is not set
CONFIG_DEBUG_USER=y


########################
### Security options ###
########################
CONFIG_KEYS=y
CONFIG_CRYPTO_USER_API_HASH=m
CONFIG_CRYPTO_USER_API_SKCIPHER=m
CONFIG_CRYPTO_DEV_ATMEL_AES=y
CONFIG_CRYPTO_DEV_ATMEL_TDES=y
CONFIG_CRYPTO_DEV_ATMEL_SHA=y
```

## EndPoint/MicroChip/u-boot-at91/board/atmel/sama5d27_sound_device/Kconfig
```kconfig
if TARGET_SAMA5D2_SOUND_DEVICE

config SYS_BOARD
	default "sama5d27_sound_device"

config SYS_VENDOR
	default "atmel"

config SYS_SOC
	default "at91"

config SYS_CONFIG_NAME
	default "sama5d27_sound_device"

endif
```
