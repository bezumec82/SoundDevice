/* microElk */
/ {
    ahb { /* Advanced high-speed bus */
        nand0: nand@80000000 {
            compatible      = "atmel,sama5d2-nand";
            #address-cells  = <1>;
            #size-cells     = <1>;
            ranges;
            atmel,nand-addr-offset  = <21>;
            atmel,nand-cmd-offset   = <22>;
            atmel,nand-has-dma;
            atmel,has-pmecc;
            atmel,pmecc-lookup-table-offset = <0x0 0x8000>;
            nfc@c0000000 {
                compatible      = "atmel,sama5d3-nfc";
                #address-cells  = <1>;
                #size-cells     = <1>;
                clocks          = <&hsmc_clk>;
                atmel,write-by-sram;
            }; /* nfc */
        }; /* nand0 */
    }; /* ahb */
}; /* / */
