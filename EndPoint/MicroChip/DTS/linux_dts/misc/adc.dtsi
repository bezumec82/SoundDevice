/* microElk */
/ {
    ahb { /* Advanced high-speed bus */
        apb { /* Advanced peripheral bus */
            adc: adc@fc030000 {
                compatible      = "atmel,sama5d2-adc";
                clocks          = <&adc_clk>;
                clock-names     = "adc_clk";
                atmel,min-sample-rate-hz    = <200000>;
                atmel,max-sample-rate-hz    = <20000000>;
                atmel,startup-time-ms       = <4>;
                atmel,trigger-edge-type     = <IRQ_TYPE_EDGE_RISING>;
            }; /* adc */
        }; /* apb */
    }; /* ahb */
}; /* / */
